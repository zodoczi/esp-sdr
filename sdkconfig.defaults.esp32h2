## sdkconfig.defaults.esp32h2
```kconfig
CONFIG_IDF_TARGET="esp32h2"
CONFIG_ESPTOOLPY_FLASHSIZE_2MB=y
CONFIG_ESP_PHY_ENABLE_CERT_TEST=y
CONFIG_ESP_PHY_DEBUG=y
CONFIG_ESP_CONSOLE_USB_SERIAL_JTAG=y
CONFIG_ESP_CONSOLE_SECONDARY_NONE=y
CONFIG_ESP_MAIN_TASK_STACK_SIZE=8192
CONFIG_FREERTOS_HZ=1000
CONFIG_COMPILER_OPTIMIZATION_PERF=y
CONFIG_ESP_DEFAULT_CPU_FREQ_MHZ_96=y
# CONFIG_PM_ENABLE is not set
# Leave enough non-modem SRAM for static data and task stacks.
# CONFIG_ESP_PHY_IRAM_OPT is not set

CONFIG_ESP_SDR_UART_ENABLED=y
CONFIG_ESP_SDR_UART_BAUD=2000000
CONFIG_ESP_SDR_UART_TX_PIN=24
CONFIG_ESP_SDR_UART_RX_PIN=23

# CONFIG_ESP_CONSOLE_UART_DEFAULT is not set
CONFIG_ESP_PHY_DISABLE_PLL_TRACK=y
```

## sdkconfig.defaults.esp32s31-stream
```kconfig
CONFIG_IDF_TARGET="esp32s31"
CONFIG_ESPTOOLPY_FLASHSIZE_16MB=y
CONFIG_ESP_PHY_ENABLE_CERT_TEST=y
CONFIG_ESP_PHY_DEBUG=y
CONFIG_ESP_PHY_DISABLE_PLL_TRACK=y
CONFIG_ESP_DEFAULT_CPU_FREQ_MHZ_320=y
CONFIG_ESP_MAIN_TASK_STACK_SIZE=8192
CONFIG_FREERTOS_HZ=1000
CONFIG_COMPILER_OPTIMIZATION_PERF=y
# CONFIG_ESP_CONSOLE_USB_SERIAL_JTAG is not set
CONFIG_ESP_CONSOLE_SECONDARY_NONE=y
CONFIG_SPIRAM=y
CONFIG_SPIRAM_MODE_OCT=y
CONFIG_SPIRAM_SPEED_250M=y
CONFIG_SPIRAM_USE_CAPS_ALLOC=y
CONFIG_SPIRAM_XIP_FROM_PSRAM=y
CONFIG_ETH_USE_ESP32_EMAC=y
# CONFIG_ETH_USE_SPI_ETHERNET is not set
CONFIG_ETH_DMA_RX_BUFFER_NUM=4
CONFIG_ETH_DMA_TX_BUFFER_NUM=12
CONFIG_ETH_DMA_BUFFER_SIZE=1536
CONFIG_ETH_IRAM_OPTIMIZATION=y
CONFIG_LWIP_TCPIP_TASK_AFFINITY_CPU0=y
CONFIG_LWIP_TCPIP_TASK_PRIO=20
CONFIG_LWIP_MAX_SOCKETS=12
CONFIG_ESP_WIFI_STATIC_RX_BUFFER_NUM=2
CONFIG_ESP_WIFI_DYNAMIC_RX_BUFFER_NUM=2
CONFIG_ESP_WIFI_DYNAMIC_TX_BUFFER_NUM=4
# CONFIG_ESP_WIFI_AMPDU_TX_ENABLED is not set
# CONFIG_ESP_WIFI_AMPDU_RX_ENABLED is not set
# CONFIG_ESP_WIFI_IRAM_OPT is not set
# CONFIG_ESP_WIFI_EXTRA_IRAM_OPT is not set
# CONFIG_ESP_WIFI_RX_IRAM_OPT is not set
# CONFIG_ESP_WIFI_SLP_IRAM_OPT is not set
# CONFIG_ESP_PHY_IRAM_OPT is not set
CONFIG_PARTITION_TABLE_CUSTOM=y
CONFIG_PARTITION_TABLE_CUSTOM_FILENAME="partitions-stream.csv"

CONFIG_ESP_CONSOLE_UART_DEFAULT=y

# The S31 ROM downloader is unreliable on this board; the RAM flasher is verified.
# CONFIG_ESPTOOLPY_NO_STUB is not set

CONFIG_ETH_TRANSMIT_MUTEX=y
```
